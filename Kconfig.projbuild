## main/Kconfig
```kconfig
menu "ESP Speech Recognition"

choice SR_MODEL_SEL
	prompt "Wake word engine"
	default SR_MODEL_WN5_QUANT
	help
		Select the Wake Word Engine to be used.

config SR_MODEL_WN3_QUANT
	bool "WakeNet 3 (quantized)"

config SR_MODEL_WN4_QUANT
	bool "WakeNet 4 (quantized)"

config SR_MODEL_WN5_QUANT
	bool "WakeNet 5 (quantized)"

config SR_MODEL_WN6_QUANT
	bool "WakeNet 6 (quantized)"

endchoice

choice SR_WAKE_WORD_SEL
	prompt "Wake word name"
	default SR_WN5_HILEXIN
	help
		Select the wake word to be used.

config SR_WN3_HILEXIN
	bool "hilexin (WakeNet3)"
	depends on SR_MODEL_WN3_QUANT

config SR_WN4_HILEXIN
	bool "hilexin (WakeNet4)"
	depends on SR_MODEL_WN4_QUANT

config SR_WN5_HILEXIN
	bool "hilexin (WakeNet5)"
	depends on SR_MODEL_WN5_QUANT || SR_MODEL_WN5_FLOAT 

config SR_WN5X2_HILEXIN
    bool "hilexin (WakeNet5X2)"
    depends on SR_MODEL_WN5_QUANT || SR_MODEL_WN5_FLOAT 

config SR_WN5X3_HILEXIN
    bool "hilexin (WakeNet5X3)"
    depends on SR_MODEL_WN5_QUANT || SR_MODEL_WN5_FLOAT 

config SR_WN5_NIHAOXIAOZHI
	bool "nihaoxiaozhi (WakeNet5)"
	depends on SR_MODEL_WN5_QUANT || SR_MODEL_WN5_FLOAT 

config SR_WN5X2_NIHAOXIAOZHI
	bool "nihaoxiaozhi (WakeNet5X2)"
	depends on SR_MODEL_WN5_QUANT || SR_MODEL_WN5_FLOAT 

config SR_WN5X3_NIHAOXIAOZHI
	bool "nihaoxiaozhi (WakeNet5X3)"
	depends on SR_MODEL_WN5_QUANT || SR_MODEL_WN5_FLOAT 

config SR_WN5X3_HIJESON
	bool "hi jeson (WakeNet5X3)"
	depends on SR_MODEL_WN5_QUANT || SR_MODEL_WN5_FLOAT 

config SR_WN5X3_NIHAOXIAOXIN
    bool "nihaoxiaoxin (WakeNet5X3)"
    depends on SR_MODEL_WN5_QUANT || SR_MODEL_WN5_FLOAT 

config SR_WN5_CUSTOMIZED_WORD
	bool "customized word (WakeNet5)"
	depends on SR_MODEL_WN5_QUANT || SR_MODEL_WN5_FLOAT 

config SR_WN6_NIHAOXIAOXIN
	bool "nihaoxiaoxin (WakeNet6)"
	depends on SR_MODEL_WN6_QUANT

config SR_WN6_CUSTOMIZED_WORD
	bool "customized word (WakeNet6)"
	depends on SR_MODEL_WN6_QUANT || SR_MODEL_WN6_FLOAT 

endchoice

choice SR_RUN_WN6_CORE

    depends on SR_MODEL_WN6_QUANT || SR_MODEL_WN6_FLOAT 

    prompt "ESP32 core to run WakeNet6"
    default SR_RUN_WM6_CORE1
    help
        Select one ESP32 core to run WakeNet6.

config SR_RUN_WN6_CORE0
    bool "core 0"

config SR_RUN_WN6_CORE1
    bool "core 1"

endchoice

choice SR_MN_MODEL_SEL
	prompt "speech commands recognition model to use"
	default CONFIG_MN1_MODEL_FLOAT
	help
		Select the model to be used.

config SR_MN1_MODEL_FLOAT
	bool "MultiNet 1 (float)"

config SR_MN1_MODEL_QUANT
	bool "MultiNet 1 (quantized)"

endchoice


choice SR_LANGUAGE_SEL
	prompt "langugae"
	default SR_MN1_CHINESE
	help
		Select the language to be used.

config SR_MN1_CHINESE_FLOAT
	bool "chinese (MultiNet1)"
	depends on SR_MN1_MODEL_FLOAT

config SR_MN1_CHINESE_QUANT
	bool "chinese (MultiNet1)"
	depends on SR_MN1_MODEL_QUANT

endchoice

config SPEECH_COMMANDS_NUM
    int "The number of speech commands"
    default 20
    help
	The number of the speech commands.

menu "Add speech commands"

config SPEECH_COMMAND_ID0
    string "ID0"
	default "da kai kong tiao"

config SPEECH_COMMAND_ID1
    string "ID1"
	default "guan bi kong tiao"

config SPEECH_COMMAND_ID2
    string "ID2"
	default "zeng da feng su"

config SPEECH_COMMAND_ID3
    string "ID3"
	default "jian xiao feng su"

config SPEECH_COMMAND_ID4
    string "ID4"
	default "sheng gao yi du"

config SPEECH_COMMAND_ID5
    string "ID5"
	default "jiang di yi du"

config SPEECH_COMMAND_ID6
    string "ID6"
	default "zhi re mo shi"

config SPEECH_COMMAND_ID7
    string "ID7"
	default "zhi leng mo shi"

config SPEECH_COMMAND_ID8
    string "ID8"
	default "song feng mo shi"

config SPEECH_COMMAND_ID9
    string "ID9"
	default "jie neng mo shi"

config SPEECH_COMMAND_ID10
    string "ID10"
	default "guan bi jie neng mo shi"

config SPEECH_COMMAND_ID11
    string "ID11"
	default "chu shi mo shi"

config SPEECH_COMMAND_ID12
    string "ID12"
	default "guan bi chu shi mo shi"

config SPEECH_COMMAND_ID13
    string "ID13"
	default "da kai lan ya"

config SPEECH_COMMAND_ID14
    string "ID14"
	default "guan bi lan ya"

config SPEECH_COMMAND_ID15
    string "ID15"
	default "bo fang ge qu"

config SPEECH_COMMAND_ID16
    string "ID16"
	default "zan ting bo fang"

config SPEECH_COMMAND_ID17
    string "ID17"
	default "ding shi yi xiao shi"

config SPEECH_COMMAND_ID18
    string "ID18"
	default "da kai dian deng"

config SPEECH_COMMAND_ID19
    string "ID19"
	default "guan bi dian deng"

config SPEECH_COMMAND_ID20
    string "ID20"
	default ""

config SPEECH_COMMAND_ID21
    string "ID21"
	default ""

config SPEECH_COMMAND_ID22
    string "ID22"
	default ""

config SPEECH_COMMAND_ID23
    string "ID23"
	default ""

config SPEECH_COMMAND_ID24
    string "ID24"
	default ""

config SPEECH_COMMAND_ID25
    string "ID25"
	default ""

config SPEECH_COMMAND_ID26
    string "ID26"
	default ""

config SPEECH_COMMAND_ID27
    string "ID27"
	default ""

config SPEECH_COMMAND_ID28
    string "ID28"
	default ""

config SPEECH_COMMAND_ID29
    string "ID29"
	default ""

config SPEECH_COMMAND_ID30
    string "ID30"
	default ""

config SPEECH_COMMAND_ID31
    string "ID31"
	default ""

config SPEECH_COMMAND_ID32
    string "ID32"
	default ""

config SPEECH_COMMAND_ID33
    string "ID33"
	default ""

config SPEECH_COMMAND_ID34
    string "ID34"
	default ""

config SPEECH_COMMAND_ID35
    string "ID35"
	default ""

config SPEECH_COMMAND_ID36
    string "ID36"
	default ""

config SPEECH_COMMAND_ID37
    string "ID37"
	default ""

config SPEECH_COMMAND_ID38
    string "ID38"
	default ""

config SPEECH_COMMAND_ID39
    string "ID39"
	default ""

config SPEECH_COMMAND_ID40
    string "ID40"
	default ""

config SPEECH_COMMAND_ID41
    string "ID41"
	default ""

config SPEECH_COMMAND_ID42
    string "ID42"
	default ""

config SPEECH_COMMAND_ID43
    string "ID43"
	default ""

config SPEECH_COMMAND_ID44
    string "ID44"
	default ""

config SPEECH_COMMAND_ID45
    string "ID45"
	default ""

config SPEECH_COMMAND_ID46
    string "ID46"
	default ""

config SPEECH_COMMAND_ID47
    string "ID47"
	default ""

config SPEECH_COMMAND_ID48
    string "ID48"
	default ""

config SPEECH_COMMAND_ID49
    string "ID49"
	default ""

config SPEECH_COMMAND_ID50
    string "ID50"
	default ""

config SPEECH_COMMAND_ID51
    string "ID51"
	default ""

config SPEECH_COMMAND_ID52
    string "ID52"
	default ""

config SPEECH_COMMAND_ID53
    string "ID53"
	default ""

config SPEECH_COMMAND_ID54
    string "ID54"
	default ""

config SPEECH_COMMAND_ID55
    string "ID55"
	default ""

config SPEECH_COMMAND_ID56
    string "ID56"
	default ""

config SPEECH_COMMAND_ID57
    string "ID57"
	default ""

config SPEECH_COMMAND_ID58
    string "ID58"
	default ""

config SPEECH_COMMAND_ID59
    string "ID59"
	default ""

config SPEECH_COMMAND_ID60
    string "ID60"
	default ""

config SPEECH_COMMAND_ID61
    string "ID61"
	default ""

config SPEECH_COMMAND_ID62
    string "ID62"
	default ""

config SPEECH_COMMAND_ID63
    string "ID63"
	default ""

config SPEECH_COMMAND_ID64
    string "ID64"
	default ""

config SPEECH_COMMAND_ID65
    string "ID65"
	default ""

config SPEECH_COMMAND_ID66
    string "ID66"
	default ""

config SPEECH_COMMAND_ID67
    string "ID67"
	default ""

config SPEECH_COMMAND_ID68
    string "ID68"
	default ""

config SPEECH_COMMAND_ID69
    string "ID69"
	default ""

config SPEECH_COMMAND_ID70
    string "ID70"
    default ""

config SPEECH_COMMAND_ID71
    string "ID71"
    default ""

config SPEECH_COMMAND_ID72
    string "ID72"
    default ""

config SPEECH_COMMAND_ID73
    string "ID73"
    default ""

config SPEECH_COMMAND_ID74
    string "ID74"
    default ""

config SPEECH_COMMAND_ID75
    string "ID75"
    default ""

config SPEECH_COMMAND_ID76
    string "ID76"
    default ""

config SPEECH_COMMAND_ID77
    string "ID77"
    default ""

config SPEECH_COMMAND_ID78
    string "ID78"
    default ""

config SPEECH_COMMAND_ID79
    string "ID79"
    default ""

config SPEECH_COMMAND_ID80
    string "ID80"
    default ""

config SPEECH_COMMAND_ID81
    string "ID81"
    default ""

config SPEECH_COMMAND_ID82
    string "ID82"
    default ""

config SPEECH_COMMAND_ID83
    string "ID83"
    default ""

config SPEECH_COMMAND_ID84
    string "ID84"
    default ""

config SPEECH_COMMAND_ID85
    string "ID85"
    default ""

config SPEECH_COMMAND_ID86
    string "ID86"
    default ""

config SPEECH_COMMAND_ID87
    string "ID87"
    default ""

config SPEECH_COMMAND_ID88
    string "ID88"
    default ""

config SPEECH_COMMAND_ID89
    string "ID89"
    default ""

config SPEECH_COMMAND_ID90
    string "ID90"
    default ""

config SPEECH_COMMAND_ID91
    string "ID91"
    default ""

config SPEECH_COMMAND_ID92
    string "ID92"
    default ""

config SPEECH_COMMAND_ID93
    string "ID93"
    default ""

config SPEECH_COMMAND_ID94
    string "ID94"
    default ""

config SPEECH_COMMAND_ID95
    string "ID95"
    default ""

config SPEECH_COMMAND_ID96
    string "ID96"
    default ""

config SPEECH_COMMAND_ID97
    string "ID97"
    default ""

config SPEECH_COMMAND_ID98
    string "ID98"
    default ""

config SPEECH_COMMAND_ID99
    string "ID99"
    default ""

endmenu

endmenu
```

## test_apps/sdkconfig.defaults
```kconfig
CONFIG_IDF_TARGET="esp32s3"
CONFIG_IDF_TARGET_ESP32S3=y
CONFIG_ESPTOOLPY_FLASHMODE_QIO=y
CONFIG_ESPTOOLPY_FLASHSIZE_16MB=y
CONFIG_PARTITION_TABLE_CUSTOM=y
CONFIG_PARTITION_TABLE_CUSTOM_FILENAME="partitions.csv"
CONFIG_PARTITION_TABLE_FILENAME="partitions.csv"
CONFIG_PARTITION_TABLE_OFFSET=0x8000
CONFIG_ESP32S3_DEFAULT_CPU_FREQ_240=y
CONFIG_ESP32S3_INSTRUCTION_CACHE_32KB=y
CONFIG_ESP32S3_DATA_CACHE_64KB=y
CONFIG_ESP32S3_DATA_CACHE_LINE_64B=y
CONFIG_ESP32S3_SPIRAM_SUPPORT=y
CONFIG_SPIRAM_MODE_OCT=y
CONFIG_SPIRAM_SPEED_80M=y
# CONFIG_ESP_SYSTEM_PANIC_PRINT_HALT is not set
CONFIG_ESP_SYSTEM_PANIC_PRINT_REBOOT=y
# CONFIG_ESP_SYSTEM_PANIC_SILENT_REBOOT is not set
# CONFIG_ESP_SYSTEM_PANIC_GDBSTUB is not set
# CONFIG_ESP_SYSTEM_GDBSTUB_RUNTIME is not set
CONFIG_ESP_SYSTEM_RTC_FAST_MEM_AS_HEAP_DEPCHECK=y
CONFIG_ESP_SYSTEM_ALLOW_RTC_FAST_MEM_AS_HEAP=y

CONFIG_MODEL_IN_SPIFFS=y
# CONFIG_MODEL_IN_SDCARD is not set
CONFIG_USE_WAKENET=y
CONFIG_SR_WN_MODEL_WN7_QUANT8=y
CONFIG_SR_WN_WN7_HILEXIN=y
# CONFIG_USE_MULTINET is not set
```
